## arch/arm/mach-rkpx2/Kconfig
```kconfig
config ARCH_RK30XX
	depends on ARCH_RKPX2
	bool

choice
	prompt "Rockchip SoC Type"
	depends on ARCH_RKPX2
	default SOC_RKPX2

config SOC_RKPX2
	bool "RKPX2"
	select ARCH_RK30XX

endchoice

choice
	prompt "RK30xx Board Type"
	depends on ARCH_RK30XX
	default MACH_RKPX2_SDK

config MACH_RKPX2_SDK
	bool "Rkpx2 sdk"

endchoice
```

## drivers/adc/plat/Kconfig
```kconfig
#
# Adc hardware configuration
#

choice
	prompt "ADC hardware drivers"
	default ADC_RK29 if ARCH_RK29
	default ADC_RKPX2 if ARCH_RKPX2 || ARCH_RK2928 || ARCH_RK3188

config ADC_NULL
	bool "NULL"

config ADC_RKPX2
	bool "RKPX2 adc interface"
        depends on ARCH_RKPX2 || ARCH_RK2928 || ARCH_RK3188
	help
		This supports the use of the ADC interface on RKPX2 processors.
endchoice
```

## drivers/video/rockchip/disp/Kconfig
```kconfig
config FB_RK_UMP
        tristate "Enable FB/UMP Integration"
        depends on FB_ROCKCHIP
		default y
```

## drivers/video/rockchip/hdmi/chips/Kconfig
```kconfig
config  HDMI_RKPX2
        bool "RKPX2 HDMI support"
        depends on LCDC_RKPX2
        help
           Support RKPX2 hdmi if you say y here

if HDMI_RKPX2
source "drivers/video/rockchip/hdmi/chips/rkpx2/Kconfig"
endif

config  HDMI_RK2928
        bool "RK2928 HDMI support"
        depends on LCDC_RK2928
        help
           Support rk2928 hdmi if you say y here

if HDMI_CAT66121
source "drivers/video/rockchip/hdmi/chips/cat66121/Kconfig"
endif

config  HDMI_RK610
        bool "RK610 HDMI support"
        depends on MFD_RK610
        help
           Support rk610 hdmi if you say y here

if HDMI_RK610
source "drivers/video/rockchip/hdmi/chips/rk610/Kconfig"
endif

config  HDMI_RK616
        bool "RK616 HDMI support"
        depends on MFD_RK616 || ARCH_RK3026
		default y
        help
           Support rk616 hdmi if you say y here

if HDMI_RK616
source "drivers/video/rockchip/hdmi/chips/rk616/Kconfig"
endif

choice
	prompt "HDMI Source LCDC select"
config HDMI_SOURCE_LCDC0
	bool "lcdc0"
config HDMI_SOURCE_LCDC1
	bool "lcdc1"
endchoice
```

## drivers/video/rockchip/lcdc/Kconfig
```kconfig
config LCDC_RKPX2
        tristate "RKPX2 lcdc support"
        depends on FB_ROCKCHIP && ARCH_RK30XX
        help
          Driver for RKPX2 lcdc .There are two lcd controllers on RKPX2

config LCDC0_RKPX2
        bool "lcdc0 support"
        depends on LCDC_RKPX2
        default y
        help
           Support RKPX2 lcdc0 if you say y here

config LCDC1_RKPX2
        bool "lcdc1 support"
        depends on LCDC_RKPX2
        default y if HDMI_RKPX2
        help
           Support RKPX2 lcdc1 if you say y here
```

## drivers/video/rockchip/rga/Kconfig
```kconfig
menu "RGA"
	depends on ARCH_RKPX2 

config RGA_RKPX2
	tristate "ROCKCHIP RKps2"
	help
	  rkpx2 rga module.

endmenu
```
